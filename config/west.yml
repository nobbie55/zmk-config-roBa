## config/west.yml
```yaml
manifest:
  remotes:
    - name: zmkfirmware
      url-base: https://github.com/zmkfirmware
    - name: kumamuk-git
      url-base: https://github.com/kumamuk-git
  projects:
    - name: zmk
      remote: zmkfirmware
      # ↓ ここで「最新版(main)」ではなく「問題が起きる前のバージョン」を指定します
      revision: f9be3ed9c08b35b1b86df24c0f04913f3b5e50f5
      import: app/west.yml
    - name: zmk-pmw3610-driver
      remote: kumamuk-git
      revision: main
  self:
    path: config
```
